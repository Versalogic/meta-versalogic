## conf/layer.conf
```bitbake
# We have a conf and classes directory, add to BBPATH
BBPATH .= ":${LAYERDIR}"

# We have a packages directory, add to BBFILES
BBFILES += "${LAYERDIR}/recipes-*/*/*.bb \
            ${LAYERDIR}/recipes-*/*/*.bbappend"

BBFILE_COLLECTIONS += "versalogic"
BBFILE_PATTERN_versalogic = "^${LAYERDIR}/"
BBFILE_PRIORITY_versalogic = "15"

LAYERSERIES_COMPAT_versalogic = "kirkstone zeus"

LAYERDEPENDS_versalogic = "core freescale-layer"

UBOOT_MAKE_TARGET = "u-boot.imx"
UBOOT_SUFFIX = "imx"
```

## conf/machine/imx6qswordtail.conf
```bitbake
#@TYPE: Machine
#@NAME: Versalogic i.MX6 Swordtail 
#@SOC: i.MX6 Quad
#@DESCRIPTION: Machine configuration for VersaLogic i.MX6 Swordtail 
#@MAINTAINER: Alan Cave <acave@versalogic.com>

MACHINEOVERRIDES =. "mx6:mx6q:mx6dl:"

require conf/machine/include/imx-base.inc
require conf/machine/include/tune-cortexa9.inc

PREFERRED_PROVIDER_virtual/bootloader_imx6qswordtail ?= "u-boot-versalogic"
PREFERRED_VERSION_u-boot-versalogic = "2017.03"

PREFERRED_PROVIDER_virtual/kernel_imx6qswordtail ?= "linux-versalogic"
PREFERRED_VERSION_linux-versalogic = "4.9.88"
KERNEL_DEVICETREE = "imx6q-swordtail.dtb imx6dl-swordtail.dtb"
KERNEL_IMAGETYPE = "zImage"

UBOOT_CONFIG ??= "spinor"

UBOOT_CONFIG[spinor] = "mx6qswordtail_config"
UBOOT_CONFIG[sd] = "mx6qswordtail_config,sdcard"
UBOOT_CONFIG[sata] = "mx6qswordtail_sata_config"
UBOOT_CONFIG[mfgtool] = "mx6qswordtail_config"

SERIAL_CONSOLE = "115200 ttymxc0"
```

## conf/machine/imx6qtetra.conf
```bitbake
#@TYPE: Machine
#@NAME: Versalogic i.MX6Q Tetra 
#@SOC: i.MX6Q
#@DESCRIPTION: Machine configuration for VersaLogic i.MX6Q Tetra
#@MAINTAINER: Alan Cave <acave@versalogic.com>

MACHINEOVERRIDES =. "mx6:mx6q:mx6dl:"

require conf/machine/include/imx-base.inc
require conf/machine/include/arm/armv7a/tune-cortexa9.inc

PREFERRED_PROVIDER_virtual/bootloader = "u-boot-versalogic"
PREFERRED_PROVIDER_virtual/bootloader:imx6qtetra = "u-boot-versalogic"
PREFERRED_VERSION_u-boot-versalogic = "2022.04%"

PREFERRED_PROVIDER_virtual/kernel = "linux-versalogic"
PREFERRED_PROVIDER_virtual/kernel:imx6qtetra = "linux-versalogic"
PREFERRED_VERSION_linux-versalogic = "5.15%"

KERNEL_DEVICETREE = "imx6q-tetra.dtb"
KERNEL_IMAGETYPE = "zImage"

PREFERRED_RPROVIDER_kernel-module-imx-gpu-viv = "linux-versalogic"

UBOOT_CONFIG ??= "spinor"

UBOOT_CONFIG[spinor] = "mx6qtetra_config"
UBOOT_CONFIG[sd] = "mx6qtetra_config,sdcard"
UBOOT_CONFIG[sata] = "mx6qtetra_sata_config"
UBOOT_CONFIG[mfgtool] = "mx6qtetra_config"

SERIAL_CONSOLE = "115200;ttymxc0"

# MACHINE_EXTRA_RDEPENDS = " xr17v35x kernel-modules"
# MACHINE_EXTRA_RRECOMMENDS = " kernel-modules"

MACHINE_FEATURES += " pci"
```

## conf/machine/imx6solozebra.conf
```bitbake
#@TYPE: Machine
#@NAME: Versalogic i.MX6Solo Zebra 
#@SOC: i.MX6Q
#@DESCRIPTION: Machine configuration for VersaLogic i.MX6Solo Zebra
#@MAINTAINER: Alan Cave <acave@versalogic.com>

include conf/machine/include/imx-base.inc
include conf/machine/include/tune-cortexa9.inc

# MACHINEOVERRIDES =. "mx6:mx6dl:mx6solo:"

PREFERRED_PROVIDER_virtual/kernel ?= "linux-versalogic"
KERNEL_DEVICETREE = "imx6solo-zebra.dtb"
KERNEL_IMAGETYPE = "zImage"

#UBOOT_CONFIG ??= "spinor"
UBOOT_CONFIG ??= "sd"
UBOOT_CONFIG[spinor] = "mx6solozebra_config"
UBOOT_CONFIG[sd] = "mx6solozebra_config,sdcard"
UBOOT_CONFIG[sata] = "mx6solozebra_sata_config"
UBOOT_CONFIG[mfgtool] = "mx6solozebra_config"

SERIAL_CONSOLE = "115200 ttymxc1"

MACHINE_FEATURES += " pci"
```

## conf/machine/imx6swordtail.conf
```bitbake
#@TYPE: Machine
#@NAME: Versalogic i.MX6 Swordtail 
#@SOC: i.MX6 Quad
#@DESCRIPTION: Machine configuration for VersaLogic i.MX6 Swordtail 
#@MAINTAINER: Alan Cave <acave@versalogic.com>

MACHINEOVERRIDES =. "mx6:mx6q:mx6dl:"

require conf/machine/include/imx-base.inc
require conf/machine/include/arm/armv7a/tune-cortexa9.inc

PREFERRED_PROVIDER_virtual/bootloader:imx6swordtail ?= "u-boot-versalogic"
PREFERRED_VERSION_u-boot-versalogic = "2022.04%"

PREFERRED_PROVIDER_vitrual/kernel = "linux-versalogic"
PREFERRED_PROVIDER_virtual/kernel:imx6swordtail ?= "linux-versalogic"
PREFERRED_VERSION_linux-versalogic = "5.15%"

KERNEL_DEVICETREE = "imx6q-swordtail.dtb imx6dl-swordtail.dtb"
KERNEL_IMAGETYPE = "zImage"

PREFERRED_RPROVIDER_kernel-module-imx-gpu-viv = "linux-versalogic"

UBOOT_CONFIG ??= "spinor"

# Change these value to build either a dual lite or quad 
# mx6dlswordtail is default. mx6qswordtail is for quad

# UBOOT_CONFIG[spinor] = "mx6dlswordtail_config"
# UBOOT_CONFIG[sd] = "mx6dlswordtail_config,sdcard"
# UBOOT_CONFIG[sata] = "mx6dlswordtail_sata_config"
# UBOOT_CONFIG[mfgtool] = "mx6dlswordtail_config"

UBOOT_CONFIG[spinor] = "mx6qswordtail_config"
UBOOT_CONFIG[sd] = "mx6qswordtail_config,sdcard"
UBOOT_CONFIG[sata] = "mx6qswordtail_sata_config"
UBOOT_CONFIG[mfgtool] = "mx6qswordtail_config"

SERIAL_CONSOLE = "115200;ttymxc0"
```

## conf/machine/imx6zebra.conf
```bitbake
#@TYPE: Machine
#@NAME: Versalogic i.MX6 Zebra 
#@SOC: i.MX6 Solo/DualLite
#@DESCRIPTION: Machine configuration for VersaLogic i.MX6 Zebra
#@MAINTAINER: Alan Cave <acave@versalogic.com>

MACHINEOVERRIDES =. "mx6:mx6q:mx6dl:"

require conf/machine/include/imx-base.inc
require conf/machine/include/arm/armv7a/tune-cortexa9.inc

PREFERRED_PROIVDER_virtual/bootloader = "u-boot-versalogic"
PREFERRED_PROVIDER_virtual/bootloader:imx6zebra = "u-boot-versalogic"
PREFERRED_VERSION_u-boot-versalogic= "2022.04%"

PREFERRED_PROVIDER_virtual/kernel = "linux-versalogic"
PREFERRED_PROVIDER_virtual/kernel:imx6zebra = "linux-versalogic"
PREFERRED_VERSION_linux-versalogic = "5.15%"

KERNEL_DEVICETREE += "imx6dl-zebra.dtb"
KERNEL_IMAGETYPE = "zImage"

PREFERRED_RPROVIDER_kernel-module-imx-gpu-viv = "linux-versalogic"

# Change these valueto build either a solo or dual lite
# mx6solozebra is default. mx6dlzebra is for dual lit

UBOOT_CONFIG ??= "spinor"

#UBOOT_CONFIG[spinor] = "mx6solozebra_config"
#UBOOT_CONFIG[sd] = "mx6solozebra_config,sdcard"
#UBOOT_CONFIG[sata] = "mx6solozebra_sata_config"
#UBOOT_CONFIG[mfgtool] = "mx6solozebra_config"

UBOOT_CONFIG[spinor] = "mx6dlzebra_config"
UBOOT_CONFIG[sd] = "mx6dlzebra_config,sdcard"
UBOOT_CONFIG[sata] = "mx6dlzebra_sata_config"
UBOOT_CONFIG[mfgtool] = "mx6dlzebra_config"

SERIAL_CONSOLES = "115200;ttymxc0"
```
